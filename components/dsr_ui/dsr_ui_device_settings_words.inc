/* Device configuration and BLU wizard labels: PL / EN / DE. */
{"Nazwa urządzenia","Device name","Gerätename"},
{"Tryb ECO","ECO mode","ECO-Modus"},
{"Strefa czasowa","Time zone","Zeitzone"},
{"Szerokość geograficzna","Latitude","Breitengrad"},
{"Długość geograficzna","Longitude","Längengrad"},
{"Serwer czasu","Time server","Zeitserver"},
{"Nazwa kanału","Channel name","Kanalname"},
{"Stan po zasileniu","Power-on state","Zustand nach Einschalten"},
{"Tryb wejścia","Input mode","Eingangsmodus"},
{"Blokada wejścia","Input lock","Eingangssperre"},
{"Automatyczne włączenie","Auto on","Automatisch einschalten"},
{"Opóźnienie włączenia (s)","Auto-on delay (s)","Einschaltverzögerung (s)"},
{"Automatyczne wyłączenie","Auto off","Automatisch ausschalten"},
{"Opóźnienie wyłączenia (s)","Auto-off delay (s)","Ausschaltverzögerung (s)"},
{"Opóźnienie po zasileniu","Power restore delay","Verzögerung nach Stromausfall"},
{"Czas po zasileniu (s)","Restore delay (s)","Wiederanlaufzeit (s)"},
{"Nazwa wejścia","Input name","Eingangsname"},
{"Typ wejścia","Input type","Eingangstyp"},
{"Wejście włączone","Input enabled","Eingang aktiviert"},
{"Odwrócenie wejścia","Invert input","Eingang invertieren"},
{"Nazwa rolety","Cover name","Rollladenname"},
{"Zamiana wejść","Swap inputs","Eingänge tauschen"},
{"Odwrócenie kierunków","Invert directions","Richtungen umkehren"},
{"Maks. otwieranie (s)","Max. opening time (s)","Max. Öffnungszeit (s)"},
{"Maks. zamykanie (s)","Max. closing time (s)","Max. Schließzeit (s)"},
{"Sterowanie lamelami","Slat control","Lamellensteuerung"},
{"Obrót lameli: otwieranie (s)","Slat opening time (s)","Lamellenöffnungszeit (s)"},
{"Obrót lameli: zamykanie (s)","Slat closing time (s)","Lamellenschließzeit (s)"},
{"Krok lameli (%)","Slat step (%)","Lamellenschritt (%)"},
{"Zachowaj pozycję lameli","Retain slat position","Lamellenposition beibehalten"},
{"Nazwa światła","Light name","Lichtname"},
{"Czas przejścia (s)","Transition time (s)","Übergangszeit (s)"},
{"Minimalna jasność (%)","Minimum brightness (%)","Minimale Helligkeit (%)"},
{"Tryb nocny","Night mode","Nachtmodus"},
{"Jasność nocna (%)","Night brightness (%)","Nachthelligkeit (%)"},
{"Korekcja gamma","Gamma correction","Gammakorrektur"},
{"Tempo ściemniania przyciskiem","Button dimming rate","Dimmgeschwindigkeit der Taste"},
{"Wi-Fi podstawowe","Primary Wi-Fi","Primäres WLAN"},
{"Nazwa sieci podstawowej","Primary network name","Primärer Netzwerkname"},
{"Hasło sieci podstawowej","Primary network password","Primäres WLAN-Passwort"},
{"Adresacja IP","IP addressing","IP-Adressierung"},
{"Adres IP","IP address","IP-Adresse"},
{"Maska podsieci","Subnet mask","Subnetzmaske"},
{"Brama sieciowa","Network gateway","Netzwerk-Gateway"},
{"Serwer DNS","DNS server","DNS-Server"},
{"Wi-Fi zapasowe","Backup Wi-Fi","Ersatz-WLAN"},
{"Nazwa sieci zapasowej","Backup network name","Ersatznetzwerkname"},
{"Hasło sieci zapasowej","Backup network password","Ersatz-WLAN-Passwort"},
{"Punkt dostępowy","Access point","Zugangspunkt"},
{"Nazwa punktu dostępowego","Access point name","Name des Zugangspunkts"},
{"Hasło punktu dostępowego","Access point password","Passwort des Zugangspunkts"},
{"Rozszerzanie zasięgu","Range extender","Reichweitenverlängerung"},
{"Sterowanie przez Bluetooth","Bluetooth control","Bluetooth-Steuerung"},
{"Połączenie z Shelly Cloud","Shelly Cloud connection","Shelly-Cloud-Verbindung"},
{"Połączenie MQTT","MQTT connection","MQTT-Verbindung"},
{"Serwer MQTT","MQTT server","MQTT-Server"},
{"Użytkownik MQTT","MQTT username","MQTT-Benutzer"},
{"Hasło MQTT","MQTT password","MQTT-Passwort"},
{"Prefiks MQTT","MQTT prefix","MQTT-Präfix"},
{"Powiadomienia RPC","RPC notifications","RPC-Benachrichtigungen"},
{"Powiadomienia statusu","Status notifications","Statusbenachrichtigungen"},
{"RPC przez MQTT","RPC over MQTT","RPC über MQTT"},
{"Sterowanie przez MQTT","MQTT control","MQTT-Steuerung"},
{"Nazwa pomiaru","Measurement name","Messungsname"},
{"Korekta temperatury (°C)","Temperature offset (°C)","Temperaturkorrektur (°C)"},
{"Próg temperatury (°C)","Temperature threshold (°C)","Temperaturschwelle (°C)"},
{"Korekta wilgotności (%)","Humidity offset (%)","Feuchtigkeitskorrektur (%)"},
{"Próg wilgotności (%)","Humidity threshold (%)","Feuchtigkeitsschwelle (%)"},
{"Termostat włączony","Thermostat enabled","Thermostat aktiviert"},
{"Nadpisanie temperatury","Temperature override","Temperaturübersteuerung"},
{"Domyślny boost (s)","Default boost (s)","Standard-Boost (s)"},
{"Domyślne nadpisanie (s)","Default override (s)","Standardübersteuerung (s)"},
{"Ochrona przed zablokowaniem","Anti-clog protection","Blockierschutz"},
{"Automatyczna kalibracja","Automatic calibration","Automatische Kalibrierung"},
{"Oszczędzanie baterii","Battery saving","Batteriesparmodus"},
{"Tryb cichy","Silent mode","Leiser Modus"},
{"Tryb beacon","Beacon mode","Beacon-Modus"},
{"Czułość ruchu","Motion sensitivity","Bewegungsempfindlichkeit"},
{"Podtrzymanie ruchu (s)","Motion blind time (s)","Bewegungssperrzeit (s)"},
{"Liczba impulsów ruchu","Motion pulse count","Bewegungsimpulszahl"},
{"Dioda LED","LED indicator","LED-Anzeige"},
{"Próg zmiany kąta","Angle change threshold","Winkelschwelle"},
{"Dźwięk przycisku","Button sound","Tastenton"},
{"Szybkość wielokliku","Multi-click speed","Mehrfachklicktempo"},
{"Znajdź urządzenie","Find device","Gerät finden"},
{"Ogrzewanie podłogowe","Floor heating","Fußbodenheizung"},
{"Przyspieszenie regulacji","Accelerated heating","Beschleunigtes Heizen"},
{"Oszczędzanie energii","Power saving","Energiesparmodus"},
{"Nadpisywanie temperatury","Temperature override","Temperaturübersteuerung"},
{"Blokada rodzicielska","Child lock","Kindersicherung"},
{"Jednostki Celsjusza","Celsius units","Celsius-Einheiten"},
{"Obróć wyświetlacz","Flip display","Anzeige drehen"},
{"Minimalne otwarcie zaworu (%)","Minimum valve opening (%)","Minimale Ventilöffnung (%)"},
{"Domyślna temperatura (°C)","Default temperature (°C)","Standardtemperatur (°C)"},
{"Minimalna temperatura (°C)","Minimum temperature (°C)","Mindesttemperatur (°C)"},
{"Maksymalna temperatura (°C)","Maximum temperature (°C)","Höchsttemperatur (°C)"},
{"Maksymalna kompensacja (°C)","Maximum compensation (°C)","Maximale Kompensation (°C)"},
{"Wymagane parowanie lub poprawny PIN. Włącz tryb parowania zgodnie z instrukcją modelu.","Pairing or the correct PIN is required. Enable pairing as described for your model.","Kopplung oder korrekte PIN erforderlich. Kopplungsmodus gemäß Modellanleitung einschalten."},
{"Ustawienie zmieniono z innego urządzenia. Odczytaj ponownie.","Another device changed this setting. Read it again.","Einstellung von einem anderen Gerät geändert. Erneut auslesen."},
{"Brak wolnego miejsca na powiązanie","No space for another bond","Kein Platz für eine weitere Kopplung"},
{"Model lub bramka nie obsługuje tej funkcji","Model or gateway does not support this feature","Modell oder Gateway unterstützt diese Funktion nicht"},
{"Nie zgadza się tożsamość urządzenia","Device identity does not match","Geräteidentität stimmt nicht überein"},
{"Operacja w toku. Poczekaj.","Operation in progress. Please wait.","Vorgang läuft. Bitte warten."},
{"Sprawdź wartość i dozwolony zakres","Check the value and allowed range","Wert und zulässigen Bereich prüfen"},
{"Nie potwierdzono operacji. Sprawdź zasięg i ponów odczyt.","Operation unconfirmed. Check the range and read again.","Vorgang unbestätigt. Reichweite prüfen und erneut auslesen."},
{"Wpisz sześciocyfrowy PIN urządzenia","Enter the six-digit device PIN","Sechsstellige Geräte-PIN eingeben"},
{"Ustawienia BLU","BLU settings","BLU-Einstellungen"},
{"Dodaj urządzenie BLU","Add BLU device","BLU-Gerät hinzufügen"},
{"Potwierdź na urządzeniu","Confirm on the device","Am Gerät bestätigen"},
{"Pierwsze parowanie: BLU TRV — krótko naciśnij Reset. Pozostałe BLU — przytrzymaj przycisk ponad 10 s, do niebieskiej diody. Uruchom skan.","First pairing: BLU TRV — briefly press Reset. Other BLU — hold the button over 10 s until the blue LED. Start scanning.","Erste Kopplung: BLU TRV — Reset kurz drücken. Andere BLU — Taste über 10 s bis zur blauen LED halten. Scan starten."},
{"Już sparowane: naciśnij krótko przycisk, aby obudzić urządzenie. Pilot zachowa istniejący PIN i szyfrowanie.","Already paired: briefly press the button to wake the device. The remote keeps its existing PIN and encryption.","Bereits gekoppelt: Taste zum Aufwecken kurz drücken. PIN und Verschlüsselung bleiben erhalten."},
{"Skanuj i połącz","Scan and connect","Scannen und verbinden"},
{"Skan Bluetooth • do 20 s","Bluetooth scan • up to 20 s","Bluetooth-Scan • bis zu 20 s"},
{"Wyszukiwanie bramek w sieci","Finding gateways on the network","Gateways im Netzwerk suchen"},
{"Dodawanie czujnika do bramki…","Adding sensor to gateway…","Sensor zum Gateway hinzufügen…"},
{"Zamykanie połączenia. Poczekaj.","Closing connection. Please wait.","Verbindung wird geschlossen. Bitte warten."},
{"Zamykanie połączenia BLE • do 4 s","Closing BLE connection • up to 4 s","BLE-Verbindung schließen • bis zu 4 s"},
{"Możesz anulować. Pilot zakończy połączenie.","You can cancel. The remote will close the connection.","Du kannst abbrechen. Die Fernbedienung beendet die Verbindung."},
{"Połączenie BLE nie zakończyło się prawidłowo. Ponów po chwili lub uruchom pilot ponownie.","The BLE connection did not close correctly. Try again shortly or restart the remote.","Die BLE-Verbindung wurde nicht korrekt beendet. Versuche es in Kürze erneut oder starte die Fernbedienung neu."},
{"Kończenie Bluetooth przed restartem…","Closing Bluetooth before restart…","Bluetooth wird vor dem Neustart beendet…"},
{"Zapisywanie i sprawdzanie ustawienia…","Saving and checking setting…","Einstellung speichern und prüfen…"},
{"Łączenie i sprawdzanie urządzenia…","Connecting and checking device…","Gerät verbinden und prüfen…"},
{"Operacja trwa. Nie restartuj pilota.","Operation in progress. Do not restart the remote.","Vorgang läuft. Fernbedienung nicht neu starten."},
{"Sparowano. Brak dodatkowych ustawień tego modelu.","Paired. No additional settings for this model.","Gekoppelt. Keine weiteren Einstellungen für dieses Modell."},
{"Wybierz bramkę Shelly","Choose Shelly gateway","Shelly-Gateway wählen"},
{"Odczytaj ponownie","Read again","Erneut auslesen"},
{"Zapomnij parowanie","Forget pairing","Kopplung vergessen"},
{"Zapomnij","Forget","Vergessen"},
{"Nie znaleziono zgodnej bramki w sieci","No compatible gateway found on the network","Kein kompatibles Gateway im Netzwerk gefunden"},
{"Ponów wyszukiwanie","Search again","Erneut suchen"},
{"Czujnik dodany. Bramka odbiera pomiary.","Sensor added. Gateway is receiving readings.","Sensor hinzugefügt. Gateway empfängt Messwerte."},
{"Czujnik zapisany na bramce. Odbiór pomiarów niepotwierdzony.","Sensor saved on gateway. Readings not yet confirmed.","Sensor am Gateway gespeichert. Messwertempfang unbestätigt."},
{"Część konfiguracji wymaga ponownego sprawdzenia. Ponowne dodanie użyje istniejącego czujnika.","Part of the setup needs checking. Adding again will reuse the existing sensor.","Ein Teil der Einrichtung muss geprüft werden. Erneutes Hinzufügen nutzt den vorhandenen Sensor."},
{"Zapisz kartę","Save card","Karte speichern"},
{"Zapis mógł dotrzeć. Wynik niepotwierdzony; odczytaj ustawienia ponownie.","The write may have arrived. Result unconfirmed; read settings again.","Schreibvorgang möglicherweise angekommen. Ergebnis unbestätigt; Einstellungen erneut auslesen."},
{"Ponów odczyt","Read again","Erneut auslesen"},
{"Usunąć powiązanie Bluetooth tego urządzenia z pilotem?","Remove this device's Bluetooth bond with the remote?","Bluetooth-Kopplung dieses Geräts mit der Fernbedienung entfernen?"},
{"Karta i konfiguracja bramki pozostaną. Ponowne połączenie będzie wymagało parowania.","The card and gateway settings stay. Connecting again will require pairing.","Karte und Gateway-Einstellungen bleiben erhalten. Erneutes Verbinden erfordert eine Kopplung."},
{"Zapisać ustawienie w czujniku BLU?","Save this setting on the BLU device?","Einstellung im BLU-Gerät speichern?"},
{"PIN urządzenia BLU","BLU device PIN","BLU-Geräte-PIN"},
{"Hasło Shelly","Shelly password","Shelly-Passwort"},
{"Sprawdź dane logowania Shelly","Check Shelly credentials","Shelly-Zugangsdaten prüfen"},
{"Ustawienia zmieniły się. Odczytaj ponownie.","Settings changed. Read again.","Einstellungen geändert. Erneut auslesen."},
{"Inne urządzenie pod tym adresem","Different device at this address","Anderes Gerät unter dieser Adresse"},
{"Ustawienie niedostępne w tym firmware","Setting unavailable in this firmware","Einstellung in dieser Firmware nicht verfügbar"},
{"Brak połączenia z Shelly","No connection to Shelly","Keine Verbindung zu Shelly"},
{"Nie potwierdzono ustawienia","Setting not confirmed","Einstellung nicht bestätigt"},
{"Ogólne","General","Allgemein"},
{"Sieć Wi-Fi","Wi-Fi network","WLAN-Netzwerk"},
{"Shelly Cloud","Shelly Cloud","Shelly Cloud"},
{"Przekaźnik","Relay","Relais"},
{"Wejście","Input","Eingang"},
{"Wilgotność","Humidity","Luftfeuchtigkeit"},
{"Oświetlenie","Lighting","Beleuchtung"},
{"Ustawienia Shelly","Shelly settings","Shelly-Einstellungen"},
{"Hasło wymaga co najmniej 8 znaków","Password requires at least 8 characters","Passwort muss mindestens 8 Zeichen enthalten"},
{"Brak dostępnych ustawień","No settings available","Keine Einstellungen verfügbar"},
{"Zmień hasło","Change password","Passwort ändern"},
{"Brak obsługiwanych pól w odpowiedzi urządzenia","No supported fields in the device response","Keine unterstützten Felder in der Geräteantwort"},
{"Odczyt i weryfikacja ustawień…","Reading and verifying settings…","Einstellungen auslesen und prüfen…"},
{"Zapis jest wykonywany jeden raz. Po utracie odpowiedzi pilot sprawdzi wynik.","Writes are sent once. If the response is lost, the remote checks the result.","Schreibvorgänge werden einmal gesendet. Bei verlorener Antwort prüft die Fernbedienung das Ergebnis."},
{"Ustawienie zapisane i potwierdzone","Setting saved and confirmed","Einstellung gespeichert und bestätigt"},
{"Shelly wymaga ponownego uruchomienia, aby zastosować zmianę.","Shelly needs a restart to apply this change.","Shelly muss zum Anwenden der Änderung neu gestartet werden."},
{"Zmiana zostanie zapisana w urządzeniu Shelly.","This change will be saved on the Shelly device.","Änderung wird im Shelly-Gerät gespeichert."},
{"Nowe hasło • ukryte","New password • hidden","Neues Passwort • verborgen"},
{"Zmiana może przerwać połączenie lub zmienić działanie urządzenia.","This change may interrupt the connection or change device behavior.","Änderung kann die Verbindung unterbrechen oder das Geräteverhalten ändern."},
{"Zapisz w Shelly","Save on Shelly","In Shelly speichern"},
{"Sieć otwarta • bez hasła","Open network • no password","Offenes Netzwerk • ohne Passwort"},
{"Parowanie TRV z bramką","Pair TRV with gateway","TRV mit Gateway koppeln"},
{"Bramka szuka głowic przez 30 s. Włącz tryb parowania tylko w wybranym TRV. Po rozpoczęciu krótko naciśnij jego przycisk Reset.","The gateway searches for 30 s. Only the selected TRV should be in pairing mode. After starting, briefly press its Reset button.","Gateway sucht 30 s lang. Nur gewählten TRV in den Kopplungsmodus versetzen. Nach dem Start dessen Reset-Taste kurz drücken."},
{"Naciśnij krótko Reset wybranego TRV. Tylko ta głowica powinna być w trybie parowania.","Briefly press Reset on the selected TRV. Only this valve should be in pairing mode.","Reset am gewählten TRV kurz drücken. Nur dieses Ventil soll im Kopplungsmodus sein."},
{"Bez hasła","No password","Ohne Passwort"},
{"Hasło Wi-Fi","Wi-Fi password","WLAN-Passwort"},
