/* PL / EN / DE. English legacy keys are accepted during the UI migration. */
{"Pamięć i radio","Memory and radio","Speicher und Funk"},{"Ładowanie, ogniwo i procent: brak wiarygodnych danych.","Charging, cell and percentage: no reliable data.","Laden, Zelle und Prozent: keine verlässlichen Daten."},
{"RAM: %lu KB wolne • min %lu KB • blok %lu KB\nPSRAM: %lu KB • grafika: %lu KB wolne\nStos ekranu: %lu B zapasu • BLE: %s","RAM: %lu KB free • min %lu KB • block %lu KB\nPSRAM: %lu KB • graphics: %lu KB free\nScreen stack: %lu B spare • BLE: %s","RAM: %lu KB frei • min %lu KB • Block %lu KB\nPSRAM: %lu KB • Grafik: %lu KB frei\nBildschirm-Stack: %lu B Reserve • BLE: %s"},
{"włączone","on","an"},{"wyłączone","off","aus"},
{" • hasło"," • password"," • Passwort"},
{"Dodaj przez Wi-Fi AP","Add via Wi-Fi AP","Über WLAN-AP hinzufügen"},
{"Fabryczne urządzenie Shelly","Factory Shelly device","Shelly im Werkszustand"},
{"Najpierw wyszukamy AP i sprawdzimy lokalne API. Dane domowej sieci wyślesz dopiero po osobnym potwierdzeniu na ekranie.","First find the AP and check its local API. Your home Wi-Fi details are sent only after a separate confirmation on this screen.","Zuerst AP suchen und lokale API prüfen. Die Zugangsdaten Ihres Heimnetzes werden erst nach einer weiteren Bestätigung gesendet."},
{"Pilot musi mieć działające domowe Wi-Fi. Obsługiwane są otwarte, fabryczne AP bez hasła API.","The remote needs working home Wi-Fi. Supports open factory APs with an unauthenticated HTTP API.","Der Pilot benötigt funktionierendes Heim-WLAN. Unterstützt werden offene Werks-APs mit HTTP-API ohne Anmeldung."},
{"Szukaj AP","Find AP","AP suchen"},
{"Fabryczne AP Shelly","Factory Shelly APs","Shelly-Werks-APs"},
{"Skanowanie Wi-Fi. Pilot pozostaje w domowej sieci.","Scanning Wi-Fi. The remote stays on your home network.","WLAN-Suche. Der Pilot bleibt im Heimnetz."},
{"Otwarty AP • do sprawdzenia","Open AP • needs verification","Offener AP • Prüfung nötig"},
{"AP chroniony • nieobsługiwany","Secured AP • unsupported","Geschützter AP • nicht unterstützt"},
{"Nie znaleziono fabrycznego AP Shelly. Włącz tryb konfiguracji urządzenia.","No factory Shelly AP found. Enable the device's setup mode.","Kein Shelly-Werks-AP gefunden. Konfigurationsmodus am Gerät aktivieren."},
{"Połączyć z AP?","Connect to AP?","Mit AP verbinden?"},
{"Pilot tymczasowo opuści domową sieć. Sterowanie Shelly i Web Panel będą niedostępne.","The remote will temporarily leave your home network. Shelly controls and the Web Panel will be unavailable.","Der Pilot verlässt vorübergehend das Heimnetz. Shelly-Steuerung und Web Panel sind dann nicht erreichbar."},
{"Wybierz własne urządzenie. Sama nazwa AP nie potwierdza jego autentyczności.","Choose your own device. An AP name alone does not prove authenticity.","Wählen Sie Ihr eigenes Gerät. Der AP-Name allein beweist keine Echtheit."},
{"Połącz z AP","Connect to AP","AP verbinden"},
{"Sprawdź punkt dostępowy","Verify access point","Zugangspunkt prüfen"},
{"Łączenie z wybranym AP i odczyt tożsamości. Dane domowego Wi-Fi nie są jeszcze wysyłane.","Connecting to the selected AP and reading its identity. Home Wi-Fi details have not been sent yet.","Verbindung zum gewählten AP und Prüfung der Identität. Heim-WLAN-Zugangsdaten werden noch nicht gesendet."},
{"Przekazać dane Wi-Fi?","Send Wi-Fi details?","WLAN-Daten senden?"},
{"Przekaż nazwę i hasło zapisanej domowej sieci temu urządzeniu. Otwarty AP i HTTP nie zapewniają kryptograficznego uwierzytelnienia.","Send the saved home network name and password to this device. An open AP and HTTP provide no cryptographic authentication.","Name und Passwort des gespeicherten Heimnetzes an dieses Gerät senden. Offener AP und HTTP bieten keine kryptografische Authentifizierung."},
{"Potwierdź tylko dla własnego Shelly. Podgląd WWW jest wstrzymany.","Confirm only for your own Shelly. Web preview is paused.","Nur für Ihr eigenes Shelly bestätigen. Web-Vorschau ist pausiert."},
{"Przekaż Wi-Fi","Send Wi-Fi","WLAN senden"},
{"Dołączanie do domu","Joining home Wi-Fi","Mit Heimnetz verbinden"},
{"Wysyłanie konfiguracji jeden raz. Następnie pilot przywróci domowe Wi-Fi i sprawdzi urządzenie w LAN.","Sending configuration once. The remote will then restore home Wi-Fi and verify the device on the LAN.","Konfiguration wird einmal gesendet. Danach stellt der Pilot das Heim-WLAN wieder her und prüft das Gerät im LAN."},
{"Sprawdź w domowej sieci","Verify on home LAN","Im Heimnetz prüfen"},
{"Pilot wrócił do domu. Szukanie tej samej tożsamości w LAN; sam zapis konfiguracji nie oznacza sukcesu.","Home Wi-Fi restored. Looking for the same identity on the LAN; saving configuration alone is not success.","Heim-WLAN wiederhergestellt. Suche nach derselben Identität im LAN; Speichern allein bedeutet keinen Erfolg."},
{"Powrót do domu","Restoring home Wi-Fi","Heim-WLAN herstellen"},
{"Przywracanie domowego Wi-Fi. Nie wyłączaj pilota.","Restoring home Wi-Fi. Keep the remote powered on.","Heim-WLAN wird wiederhergestellt. Pilot eingeschaltet lassen."},
{"Kończenie poprzedniej operacji i przywracanie domowego Wi-Fi.","Finishing the previous operation and restoring home Wi-Fi.","Vorherigen Vorgang beenden und Heim-WLAN wiederherstellen."},
{"Nie przywrócono połączenia. Ustawienia zapisane bez zmian. Anuluj ponawia powrót do domu.","Connection was not restored. Saved settings are unchanged. Cancel retries home Wi-Fi restoration.","Verbindung nicht wiederhergestellt. Gespeicherte Einstellungen bleiben erhalten. Abbrechen versucht die Wiederherstellung erneut."},
{"Kończenie operacji…","Finishing operation…","Vorgang wird beendet…"},
{"Wi-Fi AP • wynik","Wi-Fi AP • result","WLAN-AP • Ergebnis"},
{"Tożsamość urządzenia nie zgadza się. Dalsze wysyłanie zablokowane.","Device identity does not match. Further transmission is blocked.","Geräteidentität stimmt nicht überein. Weitere Übertragung gesperrt."},
{"AP wymaga logowania. Obsługiwane są fabryczne AP bez hasła API.","The AP requires sign-in. Supports factory APs with no API password.","Der AP erfordert eine Anmeldung. Unterstützt werden Werks-APs ohne API-Passwort."},
{"Ten AP lub tryb Wi-Fi nie jest obsługiwany. Dane pilota zachowane.","This AP or Wi-Fi mode is unsupported. Remote data is preserved.","Dieser AP oder WLAN-Modus wird nicht unterstützt. Pilot-Daten bleiben erhalten."},
{"Nie potwierdzono dodania. Domowe ustawienia pilota zachowane.","Adding was not confirmed. The remote's home settings are preserved.","Hinzufügen nicht bestätigt. Heimnetz-Einstellungen des Piloten bleiben erhalten."},
{"LAN, fabryczne Wi-Fi AP i skan BLE są dostępne.\nParowanie BLE nie jest jeszcze wdrożone.","LAN, factory Wi-Fi AP and BLE scanning are available.\nBLE pairing is not implemented yet.","LAN, Werks-WLAN-AP und BLE-Suche sind verfügbar.\nBLE-Kopplung ist noch nicht implementiert."},
{"Usługa LAN niedostępna. Sprawdź firmware.","LAN service unavailable. Check firmware.","LAN-Dienst nicht verfügbar. Firmware prüfen."},
{"LAN wyszukuje urządzenia w tej samej sieci.\nWi-Fi AP i Bluetooth nie są jeszcze obsługiwane.","LAN searches devices on the same network.\nWi-Fi AP and Bluetooth are not implemented yet.","LAN sucht Geräte im gleichen Netzwerk.\nWLAN-AP und Bluetooth sind noch nicht verfügbar."},
{"Tożsamość urządzenia się zmieniła. Wyszukaj ponownie.","Device identity changed. Scan again.","Geräteidentität geändert. Erneut suchen."},
{"Nie udało się zweryfikować urządzenia.","Device verification failed.","Geräteprüfung fehlgeschlagen."},
{"Dane logowania są za długie.","Credentials are too long.","Zugangsdaten sind zu lang."},
{"Sprawdź urządzenie","Verify device","Gerät prüfen"},{"Odczyt możliwości urządzenia…","Reading device capabilities…","Gerätefunktionen lesen…"},
{"Szukaj Shelly w sieci","Find Shelly on the network","Shelly im Netzwerk suchen"},
{"Wyszukiwanie mDNS i weryfikacja API…","mDNS search and API verification…","mDNS-Suche und API-Prüfung…"},
{"Ponów","Retry","Erneut versuchen"},{"Znalezione urządzenia","Discovered devices","Gefundene Geräte"},
{"Wymaga hasła","Password required","Passwort erforderlich"},{"Gotowe do sprawdzenia","Ready for verification","Bereit zur Prüfung"},
{"Nie znaleziono Shelly. Sprawdź sieć i ponów.","No Shelly found. Check the network and retry.","Kein Shelly gefunden. Netzwerk prüfen und erneut suchen."},
{"Wyszukiwanie przerwane","Search cancelled","Suche abgebrochen"},{"Zakończono wyszukiwanie","Search completed","Suche abgeschlossen"},
{"Login","Username","Benutzername"},{"Hasło Shelly","Shelly password","Shelly-Passwort"},
{"Dane logowania służą tylko wybranemu urządzeniu.","Credentials are used only for the selected device.","Zugangsdaten werden nur für das ausgewählte Gerät verwendet."},
{"Sprawdź","Verify","Prüfen"},{"Wpisz nazwę do 47 bajtów.","Enter a name up to 47 bytes.","Namen mit bis zu 47 Bytes eingeben."},
{"Nazwa i pomieszczenie","Name and room","Name und Raum"},{"Kanał z odpowiedzi API","Channel reported by API","Vom API gemeldeter Kanal"},
{"Brak obsługiwanego kanału","No supported channel","Kein unterstützter Kanal"},
{"Jedno aktywne połączenie. Zapis zastąpi poprzednie.","One active connection. Saving replaces the previous one.","Eine aktive Verbindung. Speichern ersetzt die bisherige."},
{"Urządzenie rozpoznane. Sterowanie tym typem nie jest wdrożone.","Device identified. Control for this type is not implemented.","Gerät erkannt. Steuerung für diesen Typ ist noch nicht verfügbar."},
{"Weryfikacja API: %u / %u","API verification: %u / %u","API-Prüfung: %u / %u"},
{"Wybierz pulpit","Choose dashboard","Dashboard auswählen"},
{"Włącz","on","Einschalten"},{"Wyłącz","off","Ausschalten"},{"Otwórz","open","Öffnen"},{"Zamknij","close","Schließen"},{"Stop","stop","Stopp"},
{"Dalej","Continue","Weiter"},{"Motyw","Theme","Design"},{"Język: Polski / English / Deutsch","Language: Polski / English / Deutsch","Sprache: Polski / English / Deutsch"},
{"Sterowanie roletą","Cover controls","Rollladen steuern"},{"Pozycja rolety","Cover position","Rollladenposition"},
{"Sterowanie niedostępne","Controls unavailable","Steuerung nicht verfügbar"},{"Góra / dół","Up / down","Hoch / runter"},{"Stan","Status","Status"},
{"Pokaż","Show","Zeigen"},{"Otwarta","Open","Offen"},{"Nieobsługiwane","Unsupported","Nicht unterstützt"},
{"Oświetlenie\nPrzekaźnik\nGniazdko\nRoleta\nCzujnik otwarcia\nCzujnik","Lighting\nRelay\nPlug\nCover\nContact sensor\nSensor","Beleuchtung\nRelais\nSteckdose\nRollladen\nTürsensor\nSensor"},
{"Grafitowy\nNocny","Graphite\nMidnight","Graphit\nNacht"},
{"Grafitowy\nNocny\nJasny","Graphite\nMidnight\nLight","Graphit\nNacht\nHell"},
{"Grafitowy\nNocny\nJasny\nShelly HUD — Cyber Blue","Graphite\nMidnight\nLight\nShelly HUD — Cyber Blue","Graphit\nNacht\nHell\nShelly HUD — Cyber Blue"},
{"Pokój","Room","Raum"},{"urz.","devices","Geräte"},
{"Offline • odczyty niedostępne","Offline • readings unavailable","Offline • keine Messwerte"},
{"Scena • %u działań","Scene • %u actions","Szene • %u Aktionen"},
{"Nie utworzono jeszcze pomieszczeń.\nUrządzenia pozostają dostępne w zakładce Urządzenia.","No rooms yet.\nYour devices are available under Devices.","Noch keine Räume.\nIhre Geräte finden Sie unter Geräte."},
{"Dodaj pierwsze urządzenie Shelly przyciskiem +, aby rozpocząć sterowanie swoim domem.","Add your first Shelly device with + to start controlling your home.","Fügen Sie mit + Ihr erstes Shelly-Gerät hinzu."},
{"Anulowanie…\nPoprzednie ustawienia zostają.","Cancelling...\nKeeping previous settings.","Abbrechen…\nBisherige Einstellungen bleiben."},
{"Poczekaj na zakończenie operacji.","Please wait for the current operation.","Bitte warten Sie auf den laufenden Vorgang."},
{"Hasło jest za długie (limit bajtów).","Password is too long (byte limit).","Passwort ist zu lang (Byte-Limit)."},
{"Wpisz hasło (1–63 bajty).","Enter a password (1-63 bytes).","Passwort eingeben (1–63 Bytes)."},
{"Użyj 8–63 znaków lub 64 cyfr szesnastkowych.","Use 8-63 characters or a 64-digit hex key.","8–63 Zeichen oder 64 Hex-Ziffern verwenden."},
{"Nie można rozpocząć. Spróbuj ponownie.","Cannot start. Please try again.","Start nicht möglich. Erneut versuchen."},
{"Łączenie z Wi-Fi","Connecting to Wi-Fi","WLAN-Verbindung herstellen"},
{"Logowanie i pobieranie IP…\nMoże to potrwać do 20 sekund.","Authenticating and getting an IP...\nThis can take up to 20 seconds.","Anmelden und IP beziehen…\nDies kann bis zu 20 Sekunden dauern."},
{"Połącz z Wi-Fi","Connect to Wi-Fi","Mit WLAN verbinden"},
{"Sieć otwarta\nHasło nie jest wymagane.","Open network\nNo password is required.","Offenes Netzwerk\nKein Passwort erforderlich."},
{"Ruch w tej sieci Wi-Fi nie jest szyfrowany.","Traffic on this Wi-Fi is not encrypted.","Daten in diesem WLAN sind nicht verschlüsselt."},
{"Wróć do listy sieci","Back to networks","Zur Netzwerkliste"},
{"Sieci Wi-Fi","Wi-Fi networks","WLAN-Netzwerke"},
{"Wybierz swoją sieć 2,4 GHz","Select your 2.4 GHz network","2,4-GHz-Netzwerk auswählen"},
{"Nie znaleziono sieci.\nDotknij Odśwież, aby ponowić.\nObsługiwane jest Wi-Fi 2,4 GHz.","No networks found.\nTap Refresh to scan again.\nOnly 2.4 GHz Wi-Fi is supported.","Keine Netzwerke gefunden.\nMit Aktualisieren erneut suchen.\nNur 2,4-GHz-WLAN wird unterstützt."},
{"Wyszukiwanie sieci 2,4 GHz…","Searching for 2.4 GHz networks...","2,4-GHz-Netzwerke suchen…"},
{"Poczekaj. Możesz opuścić ten ekran.","Please wait. You can leave this screen.","Bitte warten. Sie können diesen Bildschirm verlassen."},
{"Błąd wyszukiwania. Dotknij Odśwież.","Scan failed. Tap Refresh to try again.","Suche fehlgeschlagen. Aktualisieren antippen."},
{"Połączono z Wi-Fi","Wi-Fi connected","Mit WLAN verbunden"},
{"  Połączono","  Connected","  Verbunden"},
{"Adres IP: %s","IP address: %s","IP-Adresse: %s"},
{"Sieć zapisana w pilocie.\nPołączenie wznowi się automatycznie.","Network saved on this remote.\nIt will reconnect automatically.","Netzwerk gespeichert.\nVerbindung wird automatisch wiederhergestellt."},
{"Inna sieć","Other network","Anderes Netzwerk"},
{"Nie połączono. Poprzednie ustawienia zostają.","Connection failed. Previous settings kept.","Verbindung fehlgeschlagen. Bisherige Einstellungen bleiben."},
{"Błąd logowania. Sprawdź hasło.","Authentication failed. Check the password.","Anmeldung fehlgeschlagen. Passwort prüfen."},
{"Sieć niedostępna lub zmieniono zabezpieczenia.","Network unavailable or security changed.","Netzwerk nicht verfügbar oder Sicherheit geändert."},
{"Nie otrzymano IP. Sprawdź router i ponów.","No IP received. Check the router and retry.","Keine IP erhalten. Router prüfen und erneut versuchen."},
{"Nie zapisano. Poprzednie ustawienia zostają.","Could not save. Previous settings kept.","Speichern fehlgeschlagen. Bisherige Einstellungen bleiben."},
{"Gotowość","Ready","Bereit"},{"Połącz","Connect","Verbinden"},{"Anuluj","Cancel","Abbrechen"},
{"Odśwież","Refresh","Aktualisieren"},{"Hasło","Password","Passwort"},{"Pokaż hasło","Show password","Passwort anzeigen"},
{"Błąd logowania. Sprawdź dane.","Authentication failed. Check login.","Anmeldung fehlgeschlagen. Zugangsdaten prüfen."},
{"Limit logowań Shelly. Poczekaj i odśwież.","Shelly limits logins. Wait, then Refresh.","Shelly-Anmeldelimit. Warten und aktualisieren."},
{"Inne urządzenie pod tym IP. Dodaj ponownie.","Different device at this IP. Add again.","Anderes Gerät unter dieser IP. Erneut hinzufügen."},
{"Shelly offline lub brak Wi-Fi","Shelly offline / Wi-Fi disconnected","Shelly offline oder kein WLAN"},
{"Nieobsługiwana rodzina API lub kanał","Unsupported API family or channel","API-Familie oder Kanal nicht unterstützt"},
{"Błędna odpowiedź, stan niepotwierdzony","Invalid response / state unconfirmed","Ungültige Antwort, Zustand unbestätigt"},
{"Operacja w toku. Poczekaj.","Operation in progress. Please wait.","Vorgang läuft. Bitte warten."},
{"Błąd pamięci lub zapisu","Storage or memory error","Speicherfehler"},
{"Sprawdź IP, kanał i długość pól","Check IP, channel and field lengths","IP, Kanal und Feldlängen prüfen"},
{"Wpisz adres i dane logowania urządzenia.","Enter the device address and login.","Geräteadresse und Zugangsdaten eingeben."},
{"Najpierw połącz Wi-Fi","Connect Wi-Fi first","Zuerst WLAN verbinden"},
{"Błędne dane. Kanał musi być w zakresie 0–15.","Invalid details. Channel range: 0-15","Ungültige Daten. Kanal muss 0–15 sein."},
{"Sprawdzanie urządzenia przed zapisem…","Checking device before saving...","Gerät vor dem Speichern prüfen…"},
{"Dodaj urządzenie Shelly","Add Shelly device","Shelly-Gerät hinzufügen"},
{"Zaawansowane • adres IP","Advanced • IP address","Erweitert • IP-Adresse"},
{"Dodaj ręcznie (IP)","Add manually (IP)","Manuell hinzufügen (IP)"},
{"Skanuj sieć Wi-Fi","Scan Wi-Fi network","WLAN-Netzwerk durchsuchen"},
{"Wyszukiwanie LAN w kolejnym etapie.\nWi-Fi AP i Bluetooth nie są jeszcze obsługiwane.","LAN discovery is the next stage.\nWi-Fi AP and Bluetooth are not implemented yet.","LAN-Suche folgt im nächsten Schritt.\nWLAN-AP und Bluetooth sind noch nicht verfügbar."},
{"Adres IPv4 (ta sama sieć LAN)","IPv4 address (same LAN)","IPv4-Adresse (gleiches LAN)"},
{"Kanał przekaźnika (pierwszy: 0)","Relay/switch channel (first is 0)","Relaiskanal (erster: 0)"},
{"Nazwa (opcjonalnie)","Name (optional)","Name (optional)"},
{"Login (Gen2+: admin)","Login (Gen2+: admin)","Benutzer (Gen2+: admin)"},
{"Hasło Shelly (opcjonalnie)","Shelly password (optional)","Shelly-Passwort (optional)"},
{"Sprawdź i zapisz urządzenie","Check & save device","Gerät prüfen und speichern"},
{"Jedno aktywne powiązanie. Poprawna weryfikacja zastępuje poprzednie. Dane logowania są zapisane lokalnie w NVS.","Supports one relay/switch.\nA successful check replaces the saved device.\nLocal HTTP; Gen1 Basic / Gen2+ Digest.\nCredentials in unencrypted NVS.","Eine aktive Verbindung. Erfolgreiche Prüfung ersetzt die bisherige. Zugangsdaten liegen lokal in NVS."},
{"Dom","Home","Start"},{"Ustawienia","Settings","Einstellungen"},
{"Wykryto róg %u\nLiczba dotknięć: %u","Corner %u detected\nTouch count: %u","Ecke %u erkannt\nBerührungen: %u"},
{"Dotknij wszystkich czterech rogów.\nSprawdź, czy numer jest poprawny.","Tap all four corners.\nEach press should match\nthe corner number.","Alle vier Ecken berühren.\nPrüfen Sie die angezeigte Nummer."},
{"Kolory ekranu","Display colors","Displayfarben"},
{"Opis powinien odpowiadać kolorowi.","Each label should match its color.","Beschriftung und Farbe müssen übereinstimmen."},
{"CZERWONY","RED","ROT"},{"ZIELONY","GREEN","GRÜN"},{"NIEBIESKI","BLUE","BLAU"},{"BIAŁY","WHITE","WEISS"},
{"Jasność: %u%%","Brightness: %u%%","Helligkeit: %u%%"},
{"Aktualizacja firmware","Firmware Update","Firmware aktualisieren"},{"Bieżąca wersja","Current version","Aktuelle Version"},
{"Lokalna aktualizacja OTA jest dostępna w sparowanym Web Panelu. Wymaga zgody na ekranie pilota.","Local OTA is available in the paired Web Panel. Authorize it on the remote first.","Lokales OTA ist im gekoppelten Webpanel verfügbar. Zuerst auf der Fernbedienung erlauben."},
{"Wygaś ekran • dotknij, aby wybudzić","Screen off / touch to wake","Display aus • zum Wecken berühren"},
{"Ekran gaśnie po 60 sekundach.\nJasność jest ustawieniem tymczasowym.","Screen sleeps after 60 seconds.\nBrightness is temporary.","Display schläft nach 60 Sekunden.\nHelligkeit ist vorübergehend."},
{"Konfiguracja Wi-Fi","Wi-Fi setup","WLAN einrichten"},{"Testy sprzętu","Hardware tests","Hardwaretests"},
{"Jedno aktywne połączenie Shelly.\nEdycja pulpitów i lokalny panel są dostępne.","One active Shelly connection.\nDashboard editing and local panel are available.","Eine aktive Shelly-Verbindung.\nDashboard-Editor und lokales Panel sind verfügbar."},
{"Test sprzętu","Hardware test","Hardwaretest"},
{"Sprawdź kolory, dotyk, jasność i wybudzanie.","Display and touch test tools.\nCheck colors, corners and wake.","Farben, Touch, Helligkeit und Aufwecken prüfen."},
{"Kontroler dotyku: odpowiada","Touch controller: responding","Touch-Controller antwortet"},
{"Kontroler dotyku: brak odpowiedzi","Touch controller: NOT responding","Touch-Controller antwortet nicht"},
{"Sprawdź dotyk","Check touchscreen","Touch prüfen"},{"Sprawdź kolory","Check display colors","Farben prüfen"},
{"Konflikt lub zapis w toku. Wczytaj z pilota.","Conflict or save pending. Reload from remote.","Konflikt oder Speichern läuft. Neu laden."},
{"Dodaj urządzenie; limit sceny: 8 działań","Add a device; scene limit: 8 actions","Gerät hinzufügen; maximal 8 Aktionen"},
{"Najpierw usuń powiązane karty lub działania.","Remove linked cards or actions first.","Zuerst verknüpfte Karten oder Aktionen entfernen."},
{"Zachowaj przynajmniej jeden pulpit.","Keep at least one dashboard.","Mindestens ein Dashboard behalten."},
{"Najpierw dodaj obiekt tego typu","Add an item of this type first","Zuerst einen Eintrag dieses Typs hinzufügen"},
{"Urządzenia i sceny używają pełnej szerokości.","Devices and scenes use full width.","Geräte und Szenen nutzen die volle Breite."},
{"Dane wyświetlane na karcie","Card data fields","Datenfelder der Karte"},
{"Moc (W)","Power (W)","Leistung (W)"},{"Napięcie (V)","Voltage (V)","Spannung (V)"},
{"Temperatura","Temperature","Temperatur"},{"Wilgotność","Humidity","Luftfeuchtigkeit"},
{"Stan otwarcia","Contact state","Öffnungszustand"},{"Dodatkowe parametry","Additional readings","Weitere Messwerte"},
{"Zmień zdjęcie z pamięci","Change stored photo","Gespeichertes Foto ändern"},
{"Wybierz zdjęcie z pamięci","Choose stored photo","Gespeichertes Foto wählen"},
{"Dodaj pomieszczenie","Add room","Raum hinzufügen"},
{"Wybrane urządzenie","Selected device","Ausgewähltes Gerät"},
{"Pomieszczenie","Room","Raum"},
{"Model nieodczytany","Model not read","Modell nicht ausgelesen"},
{"Adres karty: %s • kanał %u","Card address: %s • channel %u","Kartenadresse: %s • Kanal %u"},
{"Zapisane ID","Stored ID","Gespeicherte ID"},
{"Tożsamość niepotwierdzona","Identity unconfirmed","Identität unbestätigt"},
{"Dostępne pomiary","Available readings","Verfügbare Messwerte"},
{"Brak aktywnego połączenia","No active connection","Keine aktive Verbindung"},
{"Brak obsługiwanych pomiarów","No supported readings","Keine unterstützten Messwerte"},
{"Odśwież status","Refresh status","Status neu laden"},
{"Edytuj kartę","Edit card","Karte bearbeiten"},
{"Edytuj kartę urządzenia","Edit device card","Gerätekarte bearbeiten"},
{"Ustawienia karty • lokalnie","Card settings • local","Karteneinstellungen • lokal"},
{"Nazwa, pokój i ikona dotyczą pilota. Konfiguracja samego Shelly wymaga obsługi API danego modelu.","Name, room and icon apply to this remote. Shelly settings require support for the model's API.","Name, Raum und Symbol gelten für diese Fernbedienung. Shelly-Einstellungen erfordern die API des Modells."},
{"Nazwa i pokój dotyczą pilota. Konfiguracja samego Shelly wymaga obsługi API danego modelu.","Name and room apply to this remote. Shelly settings require support for the model's API.","Name und Raum gelten für diese Fernbedienung. Shelly-Einstellungen erfordern die API des Modells."},
{"Historia pomiarów nie jest jeszcze dostępna.","Reading history is not available yet.","Messwerthistorie ist noch nicht verfügbar."},
{"Podaj nazwę urządzenia.","Enter a device name.","Gib einen Gerätenamen ein."},
{"Podaj krótszą nazwę urządzenia.","Enter a shorter device name.","Gib einen kürzeren Gerätenamen ein."},
{"Edytuj pomieszczenie","Edit room","Raum bearbeiten"},
{"Nowe pomieszczenie","New room","Neuer Raum"},
{"Usuń pomieszczenie","Delete room","Raum löschen"},
{"Usunąć pomieszczenie?","Delete this room?","Diesen Raum löschen?"},
{"Usunięcie pomieszczenia","Room deletion","Raum entfernen"},
{"Pomieszczenie usunięte","Room deleted","Raum gelöscht"},
{"Pomieszczenie jest używane","Room is in use","Raum wird verwendet"},
{"Utwórz pierwszy pokój, aby uporządkować urządzenia.","Create your first room to organize devices.","Erstelle deinen ersten Raum, um Geräte zu ordnen."},
{"Podaj nazwę pomieszczenia.","Enter a room name.","Gib einen Raumnamen ein."},
{"Podaj krótszą nazwę pomieszczenia.","Enter a shorter room name.","Gib einen kürzeren Raumnamen ein."},
{"Nowe zdjęcia dodasz w Web Panelu.","Add new photos in the Web Panel.","Neue Fotos im Web Panel hinzufügen."},
{"Brak zdjęć. Dodaj je w Web Panelu.","No photos yet. Add them in the Web Panel.","Noch keine Fotos. Im Web Panel hinzufügen."},
{"Brak zdjęć w pamięci. Dodaj zdjęcia w Web Panelu.","No stored photos. Upload photos in the Web Panel.","Keine gespeicherten Fotos. Fotos im Webpanel hochladen."},
{"Limit: 8 pomieszczeń. Edytuj lub usuń istniejący pokój.","Limit: 8 rooms. Edit or delete an existing room.","Limit: 8 Räume. Bestehenden Raum bearbeiten oder löschen."},
{"Poczekaj na zakończenie zapisu.","Wait for the save to finish.","Warte, bis das Speichern abgeschlossen ist."},
{"Odrzucić zmiany?","Discard changes?","Änderungen verwerfen?"},
{"Niezapisane zmiany tego formularza zostaną utracone.","Unsaved changes in this form will be lost.","Ungespeicherte Änderungen in diesem Formular gehen verloren."},
{"Zostań","Stay","Bleiben"},{"Odrzuć","Discard","Verwerfen"},
{"Urządzenia: %u • karty pomieszczenia: %u. Przenieś urządzenia i usuń te karty z pulpitów. Sceny i urządzenia pozostaną zachowane.","Devices: %u • room cards: %u. Move the devices and remove these dashboard cards first. Scenes and devices are preserved.","Geräte: %u • Raumkarten: %u. Geräte verschieben und diese Dashboard-Karten zuerst entfernen. Szenen und Geräte bleiben erhalten."},
{"Po potwierdzeniu wybierz Zapisz. Zdjęcie może być używane przez inne pokoje.","Choose Save after confirming. Other rooms may use the same photo.","Nach dem Bestätigen Speichern wählen. Andere Räume können dasselbe Foto verwenden."},
{"Zapisz, aby trwale usunąć pomieszczenie. Wstecz pozwala odrzucić zmianę.","Save to permanently delete this room. Back lets you discard the change.","Speichern löscht diesen Raum dauerhaft. Zurück erlaubt das Verwerfen der Änderung."},
{"Własne zdjęcia dodaj w lokalnym Web Panelu. Zostaną zapisane w pilocie.","Upload your photos in the local Web Panel. They are stored on the remote.","Fotos im lokalen Webpanel hochladen. Sie werden auf der Fernbedienung gespeichert."},
{"+ Działanie","+ Action","+ Aktion"},{"duża","large","groß"},{"standard","standard","Standard"},
{"Układ","Width","Breite"},{"Wys.","Height","Höhe"},
{"Poprzednie karty","Previous cards","Vorherige Karten"},{"Następne karty","Next cards","Nächste Karten"},
{"Osiągnięto limit wpisów","Item limit reached","Eintragslimit erreicht"},{"Nowy wpis","New item","Neuer Eintrag"},
{"Kolor akcentu","Accent color","Akzentfarbe"},{"Pulpit startowy","Start dashboard","Start-Dashboard"},
{"Panel niedostępny","Panel unavailable","Panel nicht verfügbar"},
{"Sprawdź odcisk certyfikatu w przeglądarce przed wpisaniem kodu.","Check the certificate fingerprint in your browser before entering the code.","Vor der Codeeingabe den Zertifikat-Fingerabdruck im Browser prüfen."},
{"SHA-256 certyfikatu tego pilota","This remote's certificate SHA-256","Zertifikat-SHA-256 dieser Fernbedienung"},
{"OTA dozwolone przez 2 minuty. Wybierz BIN w panelu.","OTA allowed for 2 minutes. Select a BIN in the panel.","OTA für 2 Minuten erlaubt. BIN im Panel auswählen."},
{"Zapisano • zsynchronizowano","Saved • synchronized","Gespeichert • synchronisiert"},
{"Niezapisane zmiany","Unsaved changes","Ungespeicherte Änderungen"},
{"Spacja","Space","Leertaste"},{"Gotowe","Done","Fertig"},
{"Błąd logowania","Authentication failed","Anmeldung fehlgeschlagen"},
{"Brak odpowiedzi","No response","Keine Antwort"},{"Zmieniona tożsamość","Identity changed","Identität geändert"},
{"Limit zapytań","Request limit","Anfragelimit"},{"Stan niepotwierdzony","State unconfirmed","Zustand unbestätigt"},
{"Nieobsługiwany kanał","Unsupported channel","Kanal nicht unterstützt"},{"Błąd pamięci","Storage error","Speicherfehler"},
{"Nieprawidłowe dane","Invalid data","Ungültige Daten"},{"Błąd komunikacji","Communication error","Kommunikationsfehler"},
{"Odczyty niedostępne","Readings unavailable","Keine Messwerte"},
{"Wysyłanie polecenia…","Sending command…","Befehl wird gesendet…"},{"Odczyt stanu…","Reading state…","Status wird gelesen…"},
{"Odśwież stan","Refresh state","Neu laden"},{"Odśwież, aby potwierdzić stan","Refresh to confirm state","Status zum Bestätigen neu laden"},
{"Zapisano wcześniejszą wersję • są niezapisane zmiany","Earlier version saved • unsaved edits remain","Vorherige Version gespeichert • Änderungen ungespeichert"},
{"Zapis nie powiódł się. Zmiany pozostają w edytorze.","Save failed. Your edits remain in the editor.","Speichern fehlgeschlagen. Änderungen bleiben im Editor."},
{"Nieprawidłowa konfiguracja. Sprawdź pola i powiązania.","Invalid configuration. Check fields and references.","Ungültige Konfiguration. Felder und Verknüpfungen prüfen."},
{"Zmieniono konfigurację. Wróć i otwórz edycję ponownie.","Configuration changed. Reopen the editor.","Konfiguration geändert. Editor erneut öffnen."},
{"Zapisywanie…","Saving…","Speichern…"},{"Zapisano A • późniejsze zmiany niezapisane","Saved A • later edits are unsaved","A gespeichert • spätere Änderungen ungespeichert"},
{"Salon\nKuchnia\nSypialnia\nŁazienka","Living room\nKitchen\nBedroom\nBathroom","Wohnzimmer\nKüche\nSchlafzimmer\nBadezimmer"},
{"Niebieski\nTurkusowy\nLawendowy\nBursztynowy\nWłasny z Web Panelu","Blue\nTurquoise\nLavender\nAmber\nCustom from Web Panel","Blau\nTürkis\nLavendel\nBernstein\nEigene Farbe aus Webpanel"},
{"Konfiguracja zmieniła się. Wczytaj ją i ponów dodawanie urządzenia.","Configuration changed; reload and retry adding the device","Konfiguration geändert. Neu laden und Gerät erneut hinzufügen."},

/* Real open-window GATT onboarding B1. */
{"Bluetooth LE • skan i setup","Bluetooth LE • scan and setup","Bluetooth LE • Suche und Setup"},
{"BLE: otwarte okno setup Gen2+. AP: otwarty punkt Shelly.","BLE: open Gen2+ setup window. AP: open Shelly access point.","BLE: offenes Gen2+-Setup. AP: offener Shelly-Zugangspunkt."},
{"Wi-Fi AP • dodaj Shelly","Wi-Fi AP • add Shelly","WLAN-AP • Shelly hinzufügen"},
{"Bluetooth • wynik","Bluetooth • result","Bluetooth • Ergebnis"},
{"Urządzenie wymaga zabezpieczonego BLE lub logowania. Ten kreator obsługuje otwarte okno konfiguracji.","Device requires secured BLE or authentication. This wizard supports the open setup window.","Gerät benötigt gesichertes BLE oder Anmeldung. Dieser Assistent unterstützt das offene Setup-Fenster."},
{"Wymagany obsługiwany Gen2+ lub H&T Gen3 w otwartym setup oraz HTTP w LAN. Bonding i fabryczne HTTPS 2.0 nie są obsługiwane.","Requires supported Gen2+ or H&T Gen3 in open setup and HTTP on LAN. Bonding and factory HTTPS 2.0 are unsupported.","Unterstütztes Gen2+ oder H&T Gen3 mit offenem Setup und HTTP im LAN erforderlich. Bonding und Werks-HTTPS 2.0 werden nicht unterstützt."},
{"Nie potwierdzono urządzenia w domowej sieci. Zapis Wi-Fi mógł dotrzeć; nie zostanie automatycznie ponowiony.","Device not confirmed on home LAN. The Wi-Fi write may have arrived; it will not be retried automatically.","Gerät im Heimnetz nicht bestätigt. WLAN-Daten könnten angekommen sein; keine automatische Wiederholung."},
{"Bluetooth • kończenie","Bluetooth • closing","Bluetooth • beenden"},
{"Zamykanie połączenia BLE. Zapis Wi-Fi nie będzie ponawiany.","Closing BLE connection. Wi-Fi configuration will not be sent again.","BLE-Verbindung wird beendet. WLAN-Daten werden nicht erneut gesendet."},
{"Sprawdź urządzenie BLE","Verify BLE device","BLE-Gerät prüfen"},
{"Łączenie GATT i odczyt tożsamości oraz możliwości. Dane domowego Wi-Fi nie są jeszcze wysyłane.","Connecting GATT and reading identity and capabilities. Home Wi-Fi details have not been sent yet.","GATT verbinden und Identität sowie Funktionen lesen. Heim-WLAN-Daten werden noch nicht gesendet."},
{"Dołączanie przez BLE","Joining via BLE","Über BLE verbinden"},
{"Ponowne sprawdzenie setup i tożsamości, jeden zapis Wi-Fi, a następnie odczyt stanu. Pilot pozostaje w domowej sieci.","Rechecking setup and identity, one Wi-Fi write, then status readback. The remote stays on the home network.","Setup und Identität erneut prüfen, WLAN einmal schreiben, dann Status lesen. Pilot bleibt im Heimnetz."},
{"Przekaż nazwę i hasło zapisanej sieci temu Shelly. Otwarte GATT nie uwierzytelnia kryptograficznie urządzenia; użyj tylko własnego sprzętu.","Send the saved network name and password to this Shelly. Open GATT does not authenticate the device cryptographically; use only your own hardware.","Name und Passwort des gespeicherten Netzes an dieses Shelly senden. Offenes GATT bietet keine kryptografische Geräteprüfung; nur eigenes Gerät verwenden."},
{"Osobne potwierdzenie na pilocie. Podgląd WWW jest wstrzymany.","Separate confirmation on the remote. Web preview is paused.","Weitere Bestätigung auf dem Piloten. Web-Vorschau pausiert."},
{"Zamykanie poprzedniej sesji. Poczekaj na potwierdzenie rozłączenia.","Closing previous session. Wait for confirmed disconnection.","Vorherige Sitzung beenden. Auf bestätigte Trennung warten."},
{"Dodać przez Bluetooth?","Add via Bluetooth?","Über Bluetooth hinzufügen?"},
{"Pilot pozostaje w domowej sieci. Najpierw sprawdzi rzeczywiste GATT i tożsamość. Sama reklama BLE nie potwierdza autentyczności.","The remote stays on home Wi-Fi. First it verifies actual GATT and identity. A BLE advertisement alone does not prove authenticity.","Pilot bleibt im Heimnetz. Zuerst werden GATT und Identität geprüft. BLE-Werbung allein beweist keine Echtheit."},
{"Tylko własny Shelly Gen2+ z przekaźnikiem lub roletą w otwartym setup. Hasło Wi-Fi wymaga kolejnej zgody.","Only your own Gen2+ Shelly with a relay or cover in open setup. Sending the Wi-Fi password requires another confirmation.","Nur eigener Gen2+-Shelly mit Relais oder Rollladen im offenen Setup. Das WLAN-Passwort erfordert eine weitere Zustimmung."},
{"Sprawdź BLE","Verify BLE","BLE prüfen"},
{"Brak potwierdzenia rozłączenia. Nowe sesje i restart są wstrzymane. Nie ponawiamy zapisu Wi-Fi.","Disconnection not confirmed. New sessions and restart are blocked. Wi-Fi configuration will not be retried.","Trennung nicht bestätigt. Neue Sitzungen und Neustart sind gesperrt. WLAN-Daten werden nicht erneut gesendet."},
{"Szukanie tej samej tożsamości oraz odczyt SSID i IP przez HTTP w LAN. Sam zapis Wi-Fi nie oznacza dodania.","Finding the same identity and reading SSID and IP over LAN HTTP. A Wi-Fi write alone does not mean the device was added.","Dieselbe Identität suchen und SSID sowie IP per HTTP im LAN lesen. WLAN-Schreiben allein bedeutet kein Hinzufügen."},
{"Otwarty setup Gen2+: sprawdź urządzenie, a następnie osobno potwierdź przekazanie Wi-Fi.","Open Gen2+ setup: verify the device, then separately confirm sharing Wi-Fi.","Offenes Gen2+-Setup: Gerät prüfen, dann WLAN-Weitergabe gesondert bestätigen."},
{"Czujnik BLU dodasz przez bramkę Shelly, która go już odbiera: Dodaj urządzenie, Skanuj sieć Wi-Fi, wybierz bramkę.","Add a BLU sensor through the Shelly gateway that already receives it: Add device, Scan Wi-Fi network, choose the gateway.","BLU-Sensor über das Shelly-Gateway hinzufügen, das ihn bereits empfängt: Gerät hinzufügen, WLAN durchsuchen, Gateway wählen."},
{"Dodaj przez BLE","Add via BLE","Über BLE hinzufügen"},
{"Urządzenie zweryfikowane. Konfiguracja zmieniła się. Dodaj ponownie.","Device verified. Configuration changed. Add again.","Gerät geprüft. Konfiguration geändert. Erneut hinzufügen."},
{"Urządzenie zweryfikowane. Zapis konfiguracji niepotwierdzony. Dodaj ponownie.","Device verified. Configuration save unconfirmed. Add again.","Gerät geprüft. Konfigurationsspeicherung unbestätigt. Erneut hinzufügen."},
{"Konfiguracja zmieniła się przed zapisem powiązania. Dodaj ponownie.","Configuration changed before binding save. Add again.","Konfiguration vor Speicherung der Verbindung geändert. Erneut hinzufügen."},
{"Konfiguracja zapisana. Nowe powiązanie niepotwierdzone. Dodaj ponownie.","Configuration saved. New binding unconfirmed. Add again.","Konfiguration gespeichert. Neue Verbindung unbestätigt. Erneut hinzufügen."},
{"Bramka BLU • przekaźnik nieobsługiwany.","BLU gateway • relay control unsupported.","BLU-Gateway • Relaissteuerung nicht unterstützt."},
{"Podgląd","Preview","Vorschau"},
{"Przegrzanie","Overtemperature","Übertemperatur"},
{"Przekroczona moc","Power limit exceeded","Leistungsgrenze überschritten"},
{"Zbyt wysokie napięcie","Overvoltage","Überspannung"},
{"Zbyt niskie napięcie","Undervoltage","Unterspannung"},
{"Przekroczony prąd","Current limit exceeded","Stromgrenze überschritten"},
{"Wykryto przeszkodę","Obstruction detected","Hindernis erkannt"},
{"Wejście bezpieczeństwa","Safety input","Sicherheitseingang"},
{"Błąd rolety","Cover error","Rollladenfehler"},
{"Ruch zablokowany","Movement blocked","Bewegung gesperrt"},
{"Brak aktualnego odczytu","No current reading","Kein aktueller Messwert"},
{"Pozycjonowanie niedostępne","Position control unavailable","Positionierung nicht verfügbar"},
{"Rodzina API","API family","API-Familie"},
{"Kanał API (pierwszy to 0)","API channel (first is 0)","API-Kanal (erster ist 0)"},
{"Do 16 połączeń.\nWybierz rodzinę API i kanał.\nProfil i kalibracja bez zmian.\nLogin w niezaszyfrowanym NVS.","Up to 16 connections.\nSelect API family and channel.\nProfile and calibration unchanged.\nCredentials in unencrypted NVS.","Bis zu 16 Verbindungen.\nAPI-Familie und Kanal auswählen.\nProfil und Kalibrierung unverändert.\nZugangsdaten in unverschlüsseltem NVS."},

{"Historia rolet nie jest obsługiwana", "Cover history is not supported", "Rollladenverlauf wird nicht unterstützt"},

/* Unified production onboarding shell, repo-owned composition. */
{"Bluetooth","Bluetooth","Bluetooth"},
{"Sieć lokalna","Local network","Lokales Netzwerk"},
{"Dodaj urządzenie","Add device","Gerät hinzufügen"},
{"Krok 1 z 3","Step 1 of 3","Schritt 1 von 3"},
{"Krok %u z 3","Step %u of 3","Schritt %u von 3"},
{"Reklamy BLE • także bez Wi-Fi","BLE discovery • works offline","BLE-Suche • auch ohne WLAN"},
{"Otwarty punkt dostępowy Shelly","Open Shelly access point","Offener Shelly-Zugangspunkt"},
{"Urządzenia w domowej sieci","Devices on your home network","Geräte im Heimnetz"},
{"Najpierw połącz domowe Wi-Fi","Connect home Wi-Fi first","Zuerst Heim-WLAN verbinden"},
{"Więcej opcji poniżej","More options below","Weitere Optionen unten"},
{"Nierozpoznane urządzenie","Unrecognized device","Nicht erkanntes Gerät"},
{"Reklama: %s","Advertised: %s","Werbung: %s"},
{"bez nazwy","unnamed","ohne Namen"},
{"Wykryto • %d dBm • niesparowane","Detected • %d dBm • unpaired","Erkannt • %d dBm • ungekoppelt"},
{"API • wymaga hasła","API • password required","API • Passwort erforderlich"},
{"Zweryfikowano API","API verified","API geprüft"},

{"Nie potwierdzono modelu ani RPC. Ta reklama nie umożliwia dodania do Wi-Fi.","Model and RPC are unverified. This advertisement cannot be used to add Wi-Fi.","Modell und RPC sind nicht bestätigt. Diese Werbung ermöglicht kein Hinzufügen zum WLAN."},
{"Jasność • Light RPC","Brightness • Light RPC","Helligkeit • Light RPC"},
{"Sterowanie światłem zablokowane","Light controls blocked","Lichtsteuerung gesperrt"},
{"Przejście do","Transition to","Übergang zu"},
{"0% jasności nie oznacza OFF","0% brightness does not mean OFF","0% Helligkeit bedeutet nicht AUS"},
{"Historia światła nie jest obsługiwana","Light history is not supported","Lichtverlauf wird nicht unterstützt"},
{"Tylko obsługiwany Shelly Gen2+ lub H&T Gen3 w otwartym setup. Hasło Wi-Fi wymaga kolejnej zgody.","Only supported Shelly Gen2+ or H&T Gen3 in open setup. Wi-Fi password requires another consent.","Nur unterstütztes Shelly Gen2+ oder H&T Gen3 im offenen Setup. WLAN-Passwort erfordert weitere Zustimmung."},
{"Kolor RGB","RGB color","RGB-Farbe"},
{"Kolor • RGB RPC","Color • RGB RPC","Farbe • RGB RPC"},
{"Jasność • RGB RPC","Brightness • RGB RPC","Helligkeit • RGB RPC"},
{"Przejście • poczekaj na odczyt","Transition • wait for readback","Übergang • Rückmeldung abwarten"},
{"Podgląd • Zastosuj wysyła kolor","Preview • Apply sends the color","Vorschau • Anwenden sendet die Farbe"},
{"RGB Plus RGBW PM","RGB Plus RGBW PM","RGB Plus RGBW PM"},
{"Jasność","Brightness","Helligkeit"},
{"Zastosuj","Apply","Anwenden"},
{"Odpowiedź odebrana %u s temu","Response received %u s ago","Antwort vor %u s empfangen"},
{"H&T Gen3 • tylko odczyt","H&T Gen3 • read only","H&T Gen3 • nur lesen"},
{"H&T Gen3 • read only","H&T Gen3 • read only","H&T Gen3 • nur lesen"},
{"Odpowiedź urządzenia odebrana","Device response received","Geräteantwort empfangen"},
{"Brak odpowiedzi • możliwe uśpienie","No response • may be asleep","Keine Antwort • Schlafmodus möglich"},
{"Zasilanie zewnętrzne: nieznane","External power: unknown","Externe Versorgung: unbekannt"},
{"Zasilanie zewnętrzne: tak","External power: yes","Externe Versorgung: ja"},
{"Zasilanie zewnętrzne: nie","External power: no","Externe Versorgung: nein"},
{"Błędy pomiarów","Measurement errors","Messfehler"},
{"Czas pomiaru nieznany. Czujnik usypia także na USB. Wybudź przyciskiem, jeśli nie odpowiada.","Measurement time unknown. Sensor sleeps even on USB. Wake by button if it does not respond.","Messzeit unbekannt. Sensor schläft auch mit USB. Bei fehlender Antwort per Taste wecken."},
{"Historia H&T nie jest obsługiwana","H&T history is not supported","H&T-Verlauf wird nicht unterstützt"},
{"Przygotowanie pamięci","Preparing storage","Speicher wird vorbereitet"},
{"Pierwsze uruchomienie: formatowanie pamięci konfiguracji.","First start: formatting configuration storage.","Erster Start: Konfigurationsspeicher wird formatiert."},
{"Poprzednie formatowanie zostało przerwane. Dokańczanie formatowania pamięci konfiguracji.","The previous format was interrupted. Completing the configuration storage format.","Die vorherige Formatierung wurde unterbrochen. Formatierung des Konfigurationsspeichers wird abgeschlossen."},
{"Wznawianie od początku…","Restarting from the beginning…","Neustart von Anfang an…"},
{"%u / %u bloków • %u%%","%u / %u blocks • %u%%","%u / %u Blöcke • %u%%"},
{"Czas: %u:%02u","Time: %u:%02u","Zeit: %u:%02u"},
{"Nie odłączaj zasilania. Zwykle trwa 1–2 minuty.","Do not disconnect power. Usually takes 1–2 minutes.","Stromversorgung nicht trennen. Dauert meist 1–2 Minuten."},
{"Nie odłączaj zasilania. Partycja nie zawiera danych użytkownika. Zwykle 1–2 minuty.","Do not disconnect power. The partition holds no user data. Usually 1–2 minutes.","Stromversorgung nicht trennen. Die Partition enthält keine Benutzerdaten. Meist 1–2 Minuten."},
{"Pamięć gotowa. Uruchamianie…","Storage ready. Starting…","Speicher bereit. Start…"},
{"Formatowanie nie powiodło się. Uruchom ponownie i zachowaj log USB.","Formatting failed. Restart and keep the USB log.","Formatierung fehlgeschlagen. Neu starten und USB-Protokoll aufbewahren."},
{"Brak powiązania • dodaj ponownie","Not bound • add again","Nicht verknüpft • erneut hinzufügen"},
{"Dodaj urządzenie ponownie przyciskiem +","Add the device again with +","Gerät mit + erneut hinzufügen"},
{"To urządzenie nie ma obsługiwanego kanału sterowania (np. bramka BLU). Nie dodano.","This device has no supported control channel (e.g. BLU gateway). Not added.","Dieses Gerät hat keinen unterstützten Steuerkanal (z. B. BLU-Gateway). Nicht hinzugefügt."},
{"Limit 16 urządzeń. Usuń jedno, aby dodać nowe.","Limit of 16 devices. Remove one to add another.","Limit von 16 Geräten. Eines entfernen, um ein neues hinzuzufügen."},
{"Nieprawidłowa odpowiedź urządzenia. Nie dodano.","Invalid device response. Not added.","Ungültige Geräteantwort. Nicht hinzugefügt."},
{"Błąd pamięci pilota. Nie dodano; zapisane dane bez zmian.","Remote storage error. Not added; saved data unchanged.","Speicherfehler der Fernbedienung. Nicht hinzugefügt; gespeicherte Daten unverändert."},
{"Sprawdź adres IP, kanał i długość pól.","Check the IP address, channel and field lengths.","IP-Adresse, Kanal und Feldlängen prüfen."},
{"Brak powiązania","Not bound","Nicht verknüpft"},
{"Shelly • model 0x%04X","Shelly • model 0x%04X","Shelly • Modell 0x%04X"},
{"Shelly • model nieznany","Shelly • unknown model","Shelly • unbekanntes Modell"},
{"Adres BLE %02X:%02X:%02X:%02X:%02X:%02X","BLE address %02X:%02X:%02X:%02X:%02X:%02X","BLE-Adresse %02X:%02X:%02X:%02X:%02X:%02X"},
{"Shelly BLU • czujnik/przycisk","Shelly BLU • sensor/button","Shelly BLU • Sensor/Taster"},
{"RPC przez BLE: włączone","RPC over BLE: enabled","RPC über BLE: aktiviert"},
{"RPC przez BLE: wyłączone","RPC over BLE: disabled","RPC über BLE: deaktiviert"},
{"RPC: do sprawdzenia po połączeniu","RPC: checked after connecting","RPC: wird nach Verbindung geprüft"},
{"Hasło włączone","Password enabled","Passwort aktiv"},
{"Tryb parowania","Pairing mode","Kopplungsmodus"},
{"RPC BLE: tak","RPC BLE: yes","RPC BLE: ja"},
{"RPC BLE: nie","RPC BLE: no","RPC BLE: nein"},
{"RPC do sprawdzenia","RPC to be checked","RPC wird geprüft"},
{"Inna reklama","Other advertisement","Andere Werbung"},
{"Historia rolet nie jest obsługiwana","Cover history is not supported","Rollladen-Verlauf wird nicht unterstützt"},
{"Offline / odczyty niedostępne","Offline / readings unavailable","Offline / Messwerte nicht verfügbar"},
{"Shelly • kanał %u","Shelly • channel %u","Shelly • Kanal %u"},
{"Ruch wykryty","Motion detected","Bewegung erkannt"},
{"Brak ruchu","No motion","Keine Bewegung"},
{"Shelly BLU • przez bramkę","Shelly BLU • via gateway","Shelly BLU • über Gateway"},
{"Odczyt z bramki odebrany","Gateway reading received","Gateway-Messwert empfangen"},
{"Bramka nie odpowiada","Gateway not responding","Gateway antwortet nicht"},
{"Przycisk","Button","Taste"},
{"Ostatni sygnał czujnika %u s temu","Last sensor signal %u s ago","Letztes Sensorsignal vor %u s"},
{"Ostatni sygnał czujnika %u min temu","Last sensor signal %u min ago","Letztes Sensorsignal vor %u min"},
{"Ostatni sygnał czujnika %u h temu","Last sensor signal %u h ago","Letztes Sensorsignal vor %u h"},
{"Czas ostatniego sygnału nieznany","Time of last signal unknown","Zeit des letzten Signals unbekannt"},
{"Bramka: brak lub błędny klucz szyfrowania","Gateway: encryption key missing or wrong","Gateway: Schlüssel fehlt oder ist falsch"},
{"Bramka: błąd danych BTHome","Gateway: BTHome data error","Gateway: BTHome-Datenfehler"},
{"Dane z bramki Shelly","Data from Shelly gateway","Daten vom Shelly-Gateway"},
{"Dane z bramki Shelly. Pilot nie łączy się z czujnikiem i niczym w nim nie steruje.","Data from the Shelly gateway. The remote does not connect to or control the sensor.","Daten vom Shelly-Gateway. Die Fernbedienung verbindet sich nicht mit dem Sensor und steuert ihn nicht."},
{"Czujnik BLU","BLU sensor","BLU-Sensor"},
{"Czujnik nie mierzy mocy","The sensor does not measure power","Der Sensor misst keine Leistung"},
{"Urządzenie offline • brak odczytu mocy","Device offline • no power reading","Gerät offline • kein Leistungswert"},
{"To urządzenie nie raportuje mocy","This device does not report power","Dieses Gerät meldet keine Leistung"},
{"Zużycie pokazuje moc z liczników Shelly.","Usage shows power from Shelly meters.","Verbrauch zeigt die Leistung der Shelly-Zähler."},
{"Ostatnia aktualizacja: brak","Last update: none","Letzte Aktualisierung: keine"},
{"Ostatnia aktualizacja: teraz","Last update: now","Letzte Aktualisierung: jetzt"},
{"Ostatnia aktualizacja: %u s temu","Last update: %u s ago","Letzte Aktualisierung: vor %u s"},
{"Licznik Shelly: %.3f kWh","Shelly meter: %.3f kWh","Shelly-Zähler: %.3f kWh"},
{"Licznik energii niedostępny","Energy meter unavailable","Energiezähler nicht verfügbar"},
{"Brak świeżego odczytu mocy","No fresh power reading","Kein aktueller Leistungswert"},
{"cel %.1f °C","target %.1f °C","Ziel %.1f °C"},
{"cel — °C","target — °C","Ziel — °C"},
{"zawór %u%%","valve %u%%","Ventil %u%%"},
{"zawór —","valve —","Ventil —"},
{"AKTUALNA\nTEMPERATURA","CURRENT\nTEMPERATURE","AKTUELLE\nTEMPERATUR"},
{"Wysyłanie do termostatu przez bramkę…","Sending to the thermostat via the gateway…","Wird über das Gateway an das Thermostat gesendet…"},
{"  cel %.1f °C  zawór %u%%","  target %.1f °C  valve %u%%","  Ziel %.1f °C  Ventil %u%%"},
{"Dotknij, aby zmienić. Własne zdjęcia dodasz w Web Panelu.","Tap to change. Add your own photos in the Web Panel.","Tippen zum Ändern. Eigene Fotos im Web Panel hinzufügen."},
{"Salon","Living room","Wohnzimmer"},
{"Kuchnia","Kitchen","Küche"},
{"Sypialnia","Bedroom","Schlafzimmer"},
{"Łazienka","Bathroom","Badezimmer"},
{"Przedpokój","Hallway","Vorraum"},
{"Piwnica","Basement","Keller"},
{"Strych","Attic","Dachboden"},
{"Rozdzielnia","Meter cabinet","Zählerkasten"},
{"Termostat BLU TRV","BLU TRV thermostat","BLU-TRV-Thermostat"},
{"Zawór","Valve","Ventil"},
{"Termostat zgłasza błąd (np. brak kalibracji)","Thermostat reports an error (e.g. not calibrated)","Thermostat meldet einen Fehler (z. B. nicht kalibriert)"},
{"Pilot wysyła nastawę do bramki Shelly, a ta do termostatu przez Bluetooth.","The remote sends the setpoint to the Shelly gateway, which forwards it to the thermostat over Bluetooth.","Die Fernbedienung sendet den Sollwert an das Shelly-Gateway, das ihn per Bluetooth an das Thermostat weitergibt."},
{"Czujniki BLU są odczytywane przez tę bramkę Shelly.","BLU sensors are read through this Shelly gateway.","BLU-Sensoren werden über dieses Shelly-Gateway gelesen."},

 {"Paruj BLU","Pair BLU","BLU koppeln"},
 {"Sparuj czujnik, ustaw jego parametry i wybierz bramkę Shelly.","Pair the sensor, adjust its settings and select a Shelly gateway.","Sensor koppeln, Einstellungen anpassen und ein Shelly-Gateway wählen."},

{"Nastawa","Target","Solltemperatur"},

{"Usuń urządzenie","Delete device","Gerät löschen"},
